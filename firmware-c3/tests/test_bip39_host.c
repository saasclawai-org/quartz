/*
 * Host test for quartz_bip39.c — cross-implementation vectors generated by
 * the reference node (quartz/crypto.py: entropy_to_mnemonic + derive_quartz_keypair).
 * Build: cc test_bip39_host.c ../main/quartz_bip39.c -lmbedcrypto -o test_bip39
 */
#include <stdio.h>
#include <string.h>
#include <stdlib.h>
#include "../main/quartz_bip39.h"

typedef struct {
    const char *entropy_hex;
    const char *words;   /* space-separated */
    const char *priv_hex;
} vector;

static int unhex(const char *hex, uint8_t *out, size_t out_max) {
    size_t n = strlen(hex) / 2;
    if (n > out_max) return -1;
    for (size_t i = 0; i < n; i++) {
        unsigned b;
        sscanf(hex + i * 2, "%2x", &b);
        out[i] = (uint8_t)b;
    }
    return (int)n;
}

static void tohex(const uint8_t *in, size_t n, char *out) {
    for (size_t i = 0; i < n; i++) sprintf(out + i * 2, "%02x", in[i]);
}

int main(void) {
    /* Filled by generator script via -DVECTORS_FILE or recompiled — see below. */
    vector vecs[] = {
        { .entropy_hex = "9f6b8a5c3d2e1f0a7b4c5d6e7f8091a2",
          .words = "panda fox novel kid tiger lunch unfold merry hover winter caught dynamic",
          .priv_hex = "8e97fe18c359faf9e6011a168c9a9845074fe61ac66bd8fa91a13d4e25d36be2" },
{ .entropy_hex = "390c8c7d7247342cd8100f2f6f770d65",
          .words = "decorate good butter tonight infant biology gate acid control knife select sleep",
          .priv_hex = "bb40ecfbc9acfce72c3394ddecd6e56c2292e0dfa82c34e757947b96cb2cdd12" },
        { .entropy_hex = "d670e58e0351d8ae8e4f6eac342fc231",
          .words = "stool mango glory allow budget firm decrease universe promote pause vacuum glove",
          .priv_hex = "97184ac8294faae60dd4cefc0037256fd477591b444f2120241ef02e8c12ecab" },
        { .entropy_hex = "b7b08716eb3fc12896b9622317749428",
          .words = "response loud shield stool winter nephew foot clump cart roof celery exotic",
          .priv_hex = "29581751fad9975de489ac96516b22b9805695e56dd69820a784829260d3a4ed" },
        { .entropy_hex = "7733c28ee8ba53bdb56b8824577d53ec",
          .words = "jaguar own photo sphere pioneer tell stick illegal cattle room female suffer",
          .priv_hex = "4fadb76c53ac5c47caedf4af0207d21447efca6ed9e118c0fa6a493eb6fdee79" },
        { .entropy_hex = "c28a70a61c7510a1cd89216ca16cffca",
          .words = "secret fatal civil decline extra extend curtain category hole arena divide night",
          .priv_hex = "f21d95fefeb87b6986d47ce236b877b9a463375ec91398196ef2c11bab3b305a" },
        { .entropy_hex = "ea4987477e86dbccb97046fc2e18384e",
          .words = "tumble equip spike wonder horror town total angle wire ignore asthma ostrich",
          .priv_hex = "5eb078c59d7bacc85ea32da330fe92980bde9fd1eb48fcc605011ecacdfdce59" },
        { .entropy_hex = NULL, .words = NULL, .priv_hex = NULL }
    };

    int fails = 0, total = 0;
    for (vector *v = vecs; v->entropy_hex; v++) {
        total++;
        uint8_t entropy[16], priv[32];
        char words[12][QZ_BIP39_WORD_MAX];

        unhex(v->entropy_hex, entropy, 16);

        if (!quartz_bip39_entropy_to_words(entropy, words)) {
            printf("FAIL %s: entropy_to_words returned false\n", v->entropy_hex);
            fails++; continue;
        }
        char got_words[200] = "";
        for (int i = 0; i < 12; i++) {
            strcat(got_words, words[i]);
            if (i < 11) strcat(got_words, " ");
        }
        if (strcmp(got_words, v->words) != 0) {
            printf("FAIL %s words:\n  got  %s\n  want %s\n", v->entropy_hex, got_words, v->words);
            fails++; continue;
        }

        if (!quartz_bip39_words_to_entropy(words, entropy)) {
            printf("FAIL %s: words_to_entropy (checksum) rejected valid words\n", v->entropy_hex);
            fails++; continue;
        }

        if (!quartz_bip39_entropy_to_privkey(entropy, priv)) {
            printf("FAIL %s: entropy_to_privkey returned false\n", v->entropy_hex);
            fails++; continue;
        }
        char got_priv[65];
        tohex(priv, 32, got_priv);
        if (strcmp(got_priv, v->priv_hex) != 0) {
            printf("FAIL %s privkey:\n  got  %s\n  want %s\n", v->entropy_hex, got_priv, v->priv_hex);
            fails++; continue;
        }
        printf("PASS %s -> %s... -> %s\n", v->entropy_hex, v->words, got_priv + 56);
    }

    /* Negative: corrupted word must be rejected */
    {
        char words[12][QZ_BIP39_WORD_MAX];
        strcpy(words[0], "abandon"); strcpy(words[1], "ability"); strcpy(words[2], "able");
        strcpy(words[3], "about");   strcpy(words[4], "above");   strcpy(words[5], "absent");
        strcpy(words[6], "absorb");  strcpy(words[7], "abstract");strcpy(words[8], "absurd");
        strcpy(words[9], "abuse");   strcpy(words[10], "access"); strcpy(words[11], "accident");
        uint8_t entropy[16];
        if (quartz_bip39_words_to_entropy(words, entropy)) {
            printf("FAIL: corrupted phrase accepted\n"); fails++;
        } else {
            printf("PASS corrupted phrase rejected\n");
        }
        total++;
    }

    printf("---\n%d vectors: %d failed\n", total, fails);
    return fails ? 1 : 0;
}
